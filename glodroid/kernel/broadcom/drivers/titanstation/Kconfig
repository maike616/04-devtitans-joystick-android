## glodroid/kernel/broadcom/drivers/titanstation/Kconfig
```kconfig
# SPDX-License-Identifier: GPL-2.0-only
#
# IPACK configuration.
#

config TITANSTATION
 tristate "Joystick module"
 default m
 depends on MODULES
 help
   Devtitans controller.
```
